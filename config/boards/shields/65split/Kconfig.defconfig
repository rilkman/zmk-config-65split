## config/boards/shields/65split/Kconfig.defconfig
```kconfig
if SHIELD_65SPLIT_LEFT

config ZMK_KEYBOARD_NAME
    default "65split"

config ZMK_SPLIT_ROLE_CENTRAL
    default y
    
endif

if SHIELD_65SPLIT_LEFT || SHIELD_65SPLIT_RIGHT

config ZMK_SPLIT
    default y

endif
```

## config/boards/shields/65split/Kconfig.shield
```kconfig
config SHIELD_65SPLIT_LEFT
    def_bool $(shields_list_contains, 65split_left)

config SHIELD_65SPLIT_RIGHT
    def_bool $(shields_list_contains, 65split_right)
```
